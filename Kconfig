## Kconfig
```kconfig
#
# Copyright (c) 2024 Jan Gnip
# Copyright (c) 2022 Nordic Semiconductor
#
# SPDX-License-Identifier: LicenseRef-Nordic-5-Clause
#

if USB
config USB_DEVICE_PID
	default 0x53A0
endif

# How often sensor data is read
config AIR_MONITOR_CHECK_PERIOD_SECONDS
	int
	default 5

# Delay after app initialization
config FIRST_AIR_MONITOR_CHECK_DELAY_SECONDS
	int
	default 5

source "Kconfig.zephyr"

module = ZIGBEE_AIR_QUALITY_MONITOR
module-str = Zigbee air quality monitor
source "subsys/logging/Kconfig.template.log_config"
```

## boards/arm/zigbee/Kconfig.board
```kconfig
# zigbee board configuration

# Copyright (c) 2018 makerdiary.com.
# SPDX-License-Identifier: Apache-2.0

config BOARD_ZIGBEE
	bool "zigbee"
	depends on SOC_NRF52840_QIAA
```

## boards/arm/zigbee/Kconfig.defconfig
```kconfig
# SOC_NRF52840_QIAA board configuration

# Copyright (c) 23 Jan Gnip
# SPDX-License-Identifier: Apache-2.0

if BOARD_ZIGBEE

config BOARD
	default "zigbee"

config BT_CTLR
	default BT

endif # BOARD_ZIGBEE
```

## boards/arm/zigbee/zigbee_defconfig
```kconfig
# SPDX-License-Identifier: Apache-2.0

CONFIG_SOC_SERIES_NRF52X=y
CONFIG_SOC_NRF52840_QIAA=y
CONFIG_BOARD_ZIGBEE=y

# Enable MPU
CONFIG_ARM_MPU=y

# enable GPIO
CONFIG_GPIO=y

# Enable hardware stack protection
CONFIG_HW_STACK_PROTECTION=y

# disable low-frequency oscillator, enable only RC Oscillator
CONFIG_CLOCK_CONTROL_NRF_K32SRC_RC=y
CONFIG_CLOCK_CONTROL_NRF_K32SRC_RC_CALIBRATION=y

# additional board options

CONFIG_GPIO_AS_PINRESET=n

# use P0.09 and P0.10 as GPIOs
CONFIG_NFCT_PINS_AS_GPIOS=y

CONFIG_PINCTRL=y

# Board Kconfig.defconfig enables USB CDC ACM and should disable USB remote
# wakeup by default. It needs to be disabled here, because the USB nrfx
# driver always overwrites option from Kconfig mentioned above with the
# imply from CONFIG_USB_NRFX.
CONFIG_USB_DEVICE_REMOTE_WAKEUP=n
```
