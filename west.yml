## west.yml
```yaml
manifest:
  projects:
    - name: nrf
      url: https://github.com/nrfconnect/sdk-nrf.git
      revision: refs/tags/v2.2.0
      import:
        # By using name-allowlist we can clone only the modules that are
        # strictly needed by the application.
        name-allowlist:
          - cmsis      # required by the ARM port
          - hal_nordic # required by the our board (Nordic based)
          - zephyr
          - nrfxlib
          - soc-hwmv1
    - name: sensirion_drivers
      path: modules/sensirion_drivers
      url: https://github.com/nobodyguy/sensirion_zephyr_drivers.git
      revision: 985e166ff664fc1117d4fc8395d3be5861ae8f3d
self:
    path: project
```
